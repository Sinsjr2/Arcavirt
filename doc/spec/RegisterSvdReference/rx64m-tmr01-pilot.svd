# RX64M_TMR01_Pilot register map
File version: 1.0
RX64M_TMR01_Pilot peripheral registers generated from iodefine.h (pilot).
Registers are 16-bit, read-write, reset 0xFFFF unless marked. A register's access mark holds for its fields unless they carry their own. Offsets are from the block's base; lines under a group give offsets from that group; [hi:lo] are bit positions; {n}, {i} and the like mark numbered series; 'fields as' and 'values as' point back to an identical list; <NAME> marks a mode.

## Memory map
0x00088204 TMR01 size 0x8
0x00088214 TMR23 size 0x8

## TMR01
Base 0x00088204
Same registers: TMR23 0x00088214
0x00 TCORA
0x02 TCORB
0x04 TCNT reset 0x0
0x06 TCCR reset 0x0
