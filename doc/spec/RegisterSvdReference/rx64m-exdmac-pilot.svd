# RX64M_EXDMAC_Pilot register map
File version: 1.0
RX64M_EXDMAC_Pilot peripheral registers generated from iodefine.h (pilot).
Registers are 32-bit, read-write, reset 0x0 unless marked. A register's access mark holds for its fields unless they carry their own. Offsets are from the block's base; lines under a group give offsets from that group; [hi:lo] are bit positions; {n}, {i} and the like mark numbered series; 'fields as' and 'values as' point back to an identical list; <NAME> marks a mode.

## Memory map
0x00082A00 EXDMAC size 0x200

## EXDMAC
Base 0x00082A00
0x00 EDMAST 8-bit
  [0] DMST
{0x1E0+4i} CLSBR{i} (i=0..7)
