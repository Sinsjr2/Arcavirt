# RX64M_ECCRAM_Pilot register map
File version: 1.0
RX64M_ECCRAM_Pilot peripheral registers generated from iodefine.h (pilot).
Registers are 8-bit, read-write, reset 0x0 unless marked. A register's access mark holds for its fields unless they carry their own. Offsets are from the block's base; lines under a group give offsets from that group; [hi:lo] are bit positions; {n}, {i} and the like mark numbered series; 'fields as' and 'values as' point back to an identical list; <NAME> marks a mode.

## Memory map
0x000812C0 ECCRAM size 0x15

## ECCRAM
Base 0x000812C0
0x00 ECCRAMMODE
  [1:0] RAMMOD
0x01 ECCRAM2STS
  [0] ECC2ERR
0x02 ECCRAM1STSEN
  [0] ECC1STSEN
0x03 ECCRAM1STS
  [0] ECC1ERR
0x04 ECCRAMPRCR
0x08 ECCRAM2ECAD 32-bit ro reset 0xFF8000
  [14:3] ECC2EAD
0x0C ECCRAM1ECAD 32-bit ro reset 0xFF8000
  [14:3] ECC1EAD
0x10 ECCRAMPRCR2
0x14 ECCRAMETST
  [0] TSTBYP
